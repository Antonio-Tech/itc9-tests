## WIFI-BLE/sdkconfig.defaults
```kconfig
# Habilitar o controlador Bluetooth
CONFIG_BT_ENABLED=y

# Configurar para usar apenas BLE (Economiza memória RAM)
CONFIG_BTDM_CTRL_MODE_BLE_ONLY=y
CONFIG_BTDM_CTRL_MODE_BR_EDR_ONLY=n
CONFIG_BTDM_CTRL_MODE_BTDM=n

# Habilitar a pilha Bluedroid
CONFIG_BT_BLUEDROID_ENABLED=y

CONFIG_PARTITION_TABLE_CUSTOM=y
CONFIG_PARTITION_TABLE_CUSTOM_FILENAME="partitions.csv"
CONFIG_ESPTOOLPY_FLASHSIZE_4MB=y
```

## display/components/WiFi/Kconfig.projbuild
```kconfig
menu "S3 Wi-Fi settings"

    menu "Wifi station settings"
        config RECONNECT_TIRES
            int "WiFi station reconnection tries"
            default 4
            range 1 20
    endmenu

    menu "Wifi Access Ponit settings"
        config S3_AP_WIFI_SSID
            string "S3 AP wifi SSID"
            default "Pixsee"
            help
                SSID (network name) to connect to.

        config S3_AP_WIFI_PASSWORD
            string "S3 AP WiFi Password"
            default "s3_password"
            help
                WiFi password (WPA3) to use.

        config S3_AP_WIFI_CHANNEL
            int "S3 AP WiFi Channel"
            range 1 13
            default 1
            help
                WiFi channel (network channel) to use.

        config ESP_MAX_STA_CONN
            int "Maximal STA connections"
            default 1
            help
                Max number of the STA connects to AP.
    endmenu
endmenu
```

## display/components/xor_decrypt_filter/Kconfig
```kconfig
menu "XOR Decryption Filter Configuration"

config USE_ENCRYPTION
    bool "Enable XOR decryption in audio pipeline"
    default y
    help
        Enable this to include XOR decryption filter in the audio pipeline.

endmenu
```

## display/main/Kconfig.projbuild
```kconfig
menu "Custom Configuration"

config USER_MODE
    bool "Enable user mode"
    default n
    help
        If enabled, runs firmware in user mode (custom feature flag).

endmenu
```
